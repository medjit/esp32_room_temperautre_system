/**
 * @file web.cpp
 * @brief HTTP server, JSON API and PIN protection (see web.h).
 *
 * MEMORY RULE (REQ-ERR-05): no response is ever built in one big String. All
 * JSON and CSV is written through ChunkedOut, which sends it to the client in
 * pieces of at most CHUNK_SIZE bytes. Memory use is therefore constant, no
 * matter how many points a history response contains.
 */

#include <WebServer.h>
#include <WiFi.h>
#include <time.h>

#include "web.h"
#include "config.h"
#include "debug.h"
#include "history.h"
#include "logic.h"
#include "netmgr.h"
#include "nodes.h"
#include "store.h"
#include "web_page.h"     // generated by tools/build_web.py: web_page_gz[], web_page_gz_len

static WebServer s_server(80);

// ---------------------------------------------------------------------------
// Chunked output writer
// ---------------------------------------------------------------------------

/**
 * Writes JSON (or any text) to the client in small chunks.
 *
 * It keeps a small buffer; whenever the buffer is full it is sent with
 * HTTP chunked transfer encoding. JSON commas are inserted automatically:
 * just call key()/value functions in order.
 *
 * Example:  out.objStart(); out.key("n"); out.num(5); out.objEnd();  ->  {"n":5}
 */
class ChunkedOut {
public:
    explicit ChunkedOut(WebServer &srv) : m_srv(srv) {}

    /** Send the response headers. Must be called once before anything else. */
    void begin(const char *contentType) {
        m_srv.sendHeader("Cache-Control", "no-store");
        m_srv.setContentLength(CONTENT_LENGTH_UNKNOWN);
        m_srv.send(200, contentType, "");
    }

    /** Flush the rest and end the chunked response. */
    void finish() {
        flush();
        m_srv.sendContent("");
    }

    // ---- plain text (used by the CSV export) ----
    void raw(const char *text, size_t len) {
        while (len > 0) {
            size_t room = CHUNK_SIZE - m_len;
            if (room == 0) { flush(); room = CHUNK_SIZE; }
            size_t take = len < room ? len : room;
            memcpy(m_buf + m_len, text, take);
            m_len += take; text += take; len -= take;
        }
    }
    void raw(const char *text) { raw(text, strlen(text)); }

    // ---- JSON structure ----
    void objStart() { beforeValue(); raw("{"); push(); }
    void objEnd()   { pop(); raw("}"); }
    void arrStart() { beforeValue(); raw("["); push(); }
    void arrEnd()   { pop(); raw("]"); }

    /** Write an object key. The next call must write its value. */
    void key(const char *name) {
        beforeValue();
        raw("\""); raw(name); raw("\":");
        m_afterKey = true;
    }

    // ---- JSON values ----
    void num(int64_t v) {
        beforeValue();
        char tmp[24];
        int n = snprintf(tmp, sizeof(tmp), "%lld", (long long)v);
        raw(tmp, (size_t)n);
    }
    void boolean(bool v) { beforeValue(); raw(v ? "true" : "false"); }
    void null()          { beforeValue(); raw("null"); }

    /** Write a string value with JSON escaping. */
    void str(const char *s) {
        beforeValue();
        raw("\"");
        for (; *s; s++) {
            const uint8_t c = (uint8_t)*s;
            if (c == '"' || c == '\\') { char e[2] = {'\\', (char)c}; raw(e, 2); }
            else if (c < 0x20)         { raw(" "); }                  // control chars become blanks
            else                       { raw(s, 1); }
        }
        raw("\"");
    }

    // ---- key + value shortcuts ----
    void kNum(const char *k, int64_t v)      { key(k); num(v); }
    void kBool(const char *k, bool v)        { key(k); boolean(v); }
    void kStr(const char *k, const char *v)  { key(k); str(v); }

private:
    static const size_t CHUNK_SIZE = 512;
    static const int    MAX_DEPTH  = 8;

    WebServer &m_srv;
    char       m_buf[CHUNK_SIZE];
    size_t     m_len = 0;
    bool       m_first[MAX_DEPTH + 1] = {true};   // "nothing written yet" per nesting level
    int        m_depth = 0;
    bool       m_afterKey = false;

    void flush() {
        if (m_len > 0) { m_srv.sendContent(m_buf, m_len); m_len = 0; }
    }
    /** Insert the comma between siblings, except directly after a key. */
    void beforeValue() {
        if (m_afterKey) { m_afterKey = false; return; }
        if (!m_first[m_depth]) raw(",");
        m_first[m_depth] = false;
    }
    void push() { if (m_depth < MAX_DEPTH) m_first[++m_depth] = true; }
    void pop()  { if (m_depth > 0) m_depth--; }
};

// ---------------------------------------------------------------------------
// Small response helpers
// ---------------------------------------------------------------------------

/** Send a short JSON error. */
static void sendError(int code, const char *message) {
    char body[160];
    snprintf(body, sizeof(body), "{\"ok\":false,\"error\":\"%s\"}", message);
    s_server.sendHeader("Cache-Control", "no-store");
    s_server.send(code, "application/json", body);
}

static void sendOk() {
    s_server.sendHeader("Cache-Control", "no-store");
    s_server.send(200, "application/json", "{\"ok\":true}");
}

/** Note web activity (delays router retries, REQ-NET-05). Call first in every handler. */
static void touch() { netNoteWebActivity(); }

// ---------------------------------------------------------------------------
// PIN protection
// ---------------------------------------------------------------------------

static uint8_t  s_pinFails    = 0;
static uint32_t s_lockUntilMs = 0;        // 0 = not locked

/**
 * Compare a PIN with the stored one without leaking, through timing, how many
 * leading characters were right. Implements: REQ-SEC-01.
 */
static bool pinMatches(const char *given) {
    const char *pin = g_settings.pin;
    uint8_t diff = (strlen(given) > 8) ? 1 : 0;
    for (size_t i = 0; i < 8; i++) {
        const char a = (i < strlen(given)) ? given[i] : 0;
        const char b = (i < strlen(pin))   ? pin[i]   : 0;
        diff |= (uint8_t)(a ^ b);
    }
    return diff == 0;
}

/**
 * Check the X-Pin header of a request. Sends the error response itself.
 *
 * Implements: REQ-SEC-01, REQ-SEC-02, REQ-WEB-08. After PIN_MAX_ATTEMPTS wrong
 * PINs in a row, every protected request is refused with 429 for
 * PIN_LOCKOUT_S seconds, for all clients.
 *
 * @return true if the request may proceed.
 */
static bool requirePin() {
    const uint32_t now = millis();

    if (s_lockUntilMs != 0) {
        if ((int32_t)(now - s_lockUntilMs) < 0) {
            sendError(429, "too many wrong PINs, try again later");
            return false;
        }
        s_lockUntilMs = 0;                  // lockout is over
        s_pinFails = 0;
    }

    if (pinMatches(s_server.header("X-Pin").c_str())) {
        s_pinFails = 0;
        return true;
    }
    if (++s_pinFails >= PIN_MAX_ATTEMPTS) {
        s_lockUntilMs = now + PIN_LOCKOUT_S * 1000UL;
        if (s_lockUntilMs == 0) s_lockUntilMs = 1;
        DBG_PRINTF("WEB: PIN lockout for %d s", PIN_LOCKOUT_S);
    }
    sendError(401, "wrong PIN");
    return false;
}

// ---------------------------------------------------------------------------
// Request argument helpers
// ---------------------------------------------------------------------------

/** Maximum accepted length of any form field (REQ-ERR-05). */
#define ARG_MAX_LEN 80

/**
 * Read an integer form/query argument and check its range.
 * @return true if the argument exists, is a number and lies within [lo, hi].
 */
static bool argInt(const char *name, long lo, long hi, long *out) {
    if (!s_server.hasArg(name)) return false;
    const String v = s_server.arg(name);
    if (v.length() == 0 || v.length() > 11) return false;

    char *end = nullptr;
    const long x = strtol(v.c_str(), &end, 10);
    if (*end != '\0' || x < lo || x > hi) return false;
    *out = x;
    return true;
}

/** @return true if the text consists only of ASCII digits and has 4..8 characters. */
static bool isValidPin(const String &s) {
    if (s.length() < 4 || s.length() > 8) return false;
    for (size_t i = 0; i < s.length(); i++) {
        if (s[i] < '0' || s[i] > '9') return false;
    }
    return true;
}

// ---------------------------------------------------------------------------
// GET /  (the page)
// ---------------------------------------------------------------------------

/**
 * Serve the embedded web page.
 * Implements: REQ-WEB-02. The page is stored gzip-compressed in flash and sent
 * as is; "no-cache" makes browsers pick up a new firmware's page.
 */
static void handleRoot() {
    touch();
    s_server.sendHeader("Content-Encoding", "gzip");
    s_server.sendHeader("Cache-Control", "no-cache");
    s_server.send_P(200, "text/html", (PGM_P)web_page_gz, web_page_gz_len);
}

/**
 * Anything unknown: in captive-portal mode send the browser to the setup page
 * (so phones open it automatically, REQ-UI-10), otherwise answer 404.
 */
static void handleNotFound() {
    touch();
    if (netCaptiveActive()) {
        s_server.sendHeader("Location", "http://" + WiFi.softAPIP().toString() + "/");
        s_server.send(302, "text/plain", "");
        return;
    }
    sendError(404, "not found");
}

// ---------------------------------------------------------------------------
// GET /api/state
// ---------------------------------------------------------------------------

/** Write the "server" part of /api/state. Implements: REQ-WEB-05, REQ-NET-07. */
static void writeServerInfo(ChunkedOut &out) {
    out.key("server"); out.objStart();
    out.kNum("fw", SERVER_FW_VERSION);
    out.kNum("uptime_s", (long)(millis() / 1000UL));
    out.kNum("heap_free", (long)ESP.getFreeHeap());
    out.kNum("heap_min", (long)ESP.getMinFreeHeap());
    out.kBool("time_valid", netTimeValid());
    out.kNum("epoch", netTimeValid() ? (long)time(nullptr) : 0);
    out.kBool("pin_default", storePinIsDefault());
    out.kNum("max_nodes", MAX_NODES);
    out.kStr("hostname", MDNS_HOSTNAME ".local");

    out.key("wifi"); out.objStart();
    const bool sta = netStaConnected();
    out.kStr("mode", netModeName());
    out.kBool("connected", sta);
    out.kBool("has_credentials", netHasCredentials());
    out.kStr("ssid", sta ? WiFi.SSID().c_str() : g_settings.ssid);
    out.kStr("ip", (sta ? WiFi.localIP() : WiFi.softAPIP()).toString().c_str());
    out.kNum("channel", netChannel());
    out.kNum("rssi", sta ? WiFi.RSSI() : 0);
    out.kStr("ap_ssid", AP_SSID);
    out.objEnd();

    out.key("stats"); out.objStart();
    out.kNum("frames", (long)g_stats.frames);
    out.kNum("accepted", (long)g_stats.accepted);
    out.kNum("duplicates", (long)g_stats.duplicates);
    out.kNum("bad_len", (long)g_stats.badLen);
    out.kNum("bad_ver", (long)g_stats.badVer);
    out.kNum("bad_crc", (long)g_stats.badCrc);
    out.kNum("unknown", (long)g_stats.unknownNode);
    out.kNum("overflow", (long)g_stats.overflow);
    out.objEnd();

    out.key("unknown_ids"); out.arrStart();
    uint8_t ids[8];
    const uint8_t count = nodeUnknownIds(ids, sizeof(ids));
    for (uint8_t i = 0; i < count; i++) out.num(ids[i]);
    out.arrEnd();

    out.objEnd();
}

/** Write one node of /api/state. Implements: REQ-WEB-05, REQ-DATA-02..04. */
static void writeNode(ChunkedOut &out, const NodeSlot &n, uint32_t nowMs) {
    out.objStart();
    out.kNum("id", n.nodeId);
    out.kStr("name", n.name);
    out.kNum("corner", n.corner);
    out.kStr("status", statusName(n.status));
    out.kNum("cpu_offset_cC", n.cpuOffsetCc);
    out.kNum("sleep_s", (long)nodeSleepSeconds(n));
    out.kNum("stuck_after_s", (long)(stuckTimeoutMs(nodeSleepSeconds(n)) / 1000UL));
    out.kNum("rx", (long)n.rxCount);
    out.kNum("dups", (long)n.dupCount);
    out.kNum("crc_err", (long)n.crcErrCount);
    out.kBool("has_data", n.haveLast);

    if (n.haveLast) {
        const NodePacket &p = n.last;
        const RoomTemp t = pickTemperature(p, n.cpuOffsetCc);
        out.kNum("age_s", (long)((nowMs - n.lastRxMs) / 1000UL));
        if (t.src == SRC_NONE) { out.key("temp_cC"); out.null(); }
        else                   { out.kNum("temp_cC", t.cC); }
        out.kStr("src", t.src == SRC_DS ? "ds" : t.src == SRC_EST ? "est" : "none");
        if (p.cpu_temp_cC == TEMP_INVALID) { out.key("cpu_cC"); out.null(); }
        else                               { out.kNum("cpu_cC", p.cpu_temp_cC); }
        out.kNum("bat_mv", p.battery_mv);
        out.kNum("bat_state", p.battery_state);
        out.kNum("bat_pct", batteryPercent(p.battery_mv));
        out.kBool("charging", p.is_charging != 0);
        out.kNum("vbus_mv", p.vbus_mv);
        out.kNum("rssi", n.rssi);
        out.kNum("flags", p.status_flags);
        out.kNum("node_fw", p.fw_version);
        out.kNum("boot", (long)p.boot_count);
    }
    out.objEnd();
}

/** GET /api/state. Implements: REQ-WEB-04, REQ-WEB-05, REQ-UI-04. */
static void handleState() {
    touch();
    ChunkedOut out(s_server);
    out.begin("application/json");
    const uint32_t now = millis();

    out.objStart();
    writeServerInfo(out);
    out.kStr("room", g_settings.room);

    out.key("ui"); out.objStart();
    out.kNum("tmin", UI_TEMP_MIN_C);
    out.kNum("tmax", UI_TEMP_MAX_C);
    out.kNum("poll_s", UI_POLL_S);
    out.objEnd();

    out.key("nodes"); out.arrStart();
    for (int i = 0; i < MAX_NODES; i++) {
        if (g_nodes[i].used) writeNode(out, g_nodes[i], now);
    }
    out.arrEnd();
    out.objEnd();
    out.finish();
}

// ---------------------------------------------------------------------------
// GET /api/history, /api/export.csv
// ---------------------------------------------------------------------------

/** Merged samples of the current history response (static: too big for the stack). */
static Sample s_histOut[HIST_API_MAX_POINTS];

/** Find the slot named by the `node` query argument, or send 404. @return slot index or -1. */
static int slotFromQuery() {
    long id;
    if (!argInt("node", 0, 255, &id)) { sendError(400, "node missing"); return -1; }
    const int idx = nodeFindIndex((uint8_t)id);
    if (idx < 0) sendError(404, "unknown node");
    return idx;
}

/**
 * GET /api/history?node=<id>&from=<ts>
 *
 * Implements: REQ-HIST-06, REQ-WEB-04. The answer holds parallel arrays, which
 * keeps it compact:  t = time, v = room temp (0.01 C or null), s = source
 * (0 none, 1 ds, 2 est), c = raw CPU temp, b = battery mV. `step` tells how
 * many stored samples were merged into each point (1 = no merging).
 */
static void handleHistory() {
    touch();
    const int idx = slotFromQuery();
    if (idx < 0) return;
    const NodeSlot &n = g_nodes[idx];

    // `from` is an unsigned 32-bit timestamp, so it is parsed on its own (argInt() uses long).
    uint32_t from = 0;
    if (s_server.hasArg("from")) from = (uint32_t)strtoul(s_server.arg("from").c_str(), nullptr, 10);

    uint16_t step = 1;
    const uint16_t count = histDownsample(n.hist, from, HIST_API_MAX_POINTS, s_histOut, &step);

    ChunkedOut out(s_server);
    out.begin("application/json");
    out.objStart();
    out.kNum("node", n.nodeId);
    out.kNum("step", step);
    out.kNum("sleep_s", (long)nodeSleepSeconds(n));
    out.kBool("time_valid", netTimeValid());
    out.kNum("now", (long)netStamp());

    out.key("t"); out.arrStart();
    for (uint16_t i = 0; i < count; i++) out.num((long)s_histOut[i].ts);
    out.arrEnd();

    out.key("v"); out.arrStart();
    for (uint16_t i = 0; i < count; i++) {
        if (s_histOut[i].room_cC == TEMP_INVALID) out.null(); else out.num(s_histOut[i].room_cC);
    }
    out.arrEnd();

    out.key("s"); out.arrStart();
    for (uint16_t i = 0; i < count; i++) out.num(sampleSource(s_histOut[i]));
    out.arrEnd();

    out.key("c"); out.arrStart();
    for (uint16_t i = 0; i < count; i++) {
        if (s_histOut[i].cpu_cC == TEMP_INVALID) out.null(); else out.num(s_histOut[i].cpu_cC);
    }
    out.arrEnd();

    out.key("b"); out.arrStart();
    for (uint16_t i = 0; i < count; i++) out.num(s_histOut[i].bat_mv);
    out.arrEnd();

    out.objEnd();
    out.finish();
}

/**
 * GET /api/export.csv?node=<id>   (MAY requirement, REQ-WEB-04)
 *
 * One line per stored sample, no merging. The `utc` column is empty for
 * samples recorded before the clock was known; `ts` then holds virtual seconds.
 */
static void handleExportCsv() {
    touch();
    const int idx = slotFromQuery();
    if (idx < 0) return;
    const NodeSlot &n = g_nodes[idx];

    ChunkedOut out(s_server);
    out.begin("text/csv");
    out.raw("ts,utc,room_C,source,cpu_C,battery_mV,battery_state,charging\n");

    for (uint16_t i = 0; i < n.hist.count; i++) {
        const Sample &s = histAt(n.hist, i);

        char utc[24] = "";
        if (!stampIsVirtual(s.ts)) {
            const time_t t = (time_t)s.ts;
            struct tm tmv;
            gmtime_r(&t, &tmv);
            strftime(utc, sizeof(utc), "%Y-%m-%dT%H:%M:%SZ", &tmv);
        }
        char room[12] = "", cpu[12] = "";
        if (s.room_cC != TEMP_INVALID) snprintf(room, sizeof(room), "%.2f", s.room_cC / 100.0);
        if (s.cpu_cC  != TEMP_INVALID) snprintf(cpu,  sizeof(cpu),  "%.2f", s.cpu_cC / 100.0);

        char line[120];
        const int len = snprintf(line, sizeof(line), "%lu,%s,%s,%u,%s,%u,%u,%u\n",
                                 (unsigned long)s.ts, utc, room, (unsigned)sampleSource(s), cpu,
                                 (unsigned)s.bat_mv, (unsigned)sampleBatState(s),
                                 sampleCharging(s) ? 1u : 0u);
        out.raw(line, (size_t)len);
    }
    out.finish();
}

// ---------------------------------------------------------------------------
// Wi-Fi: scan and credentials
// ---------------------------------------------------------------------------

/**
 * GET /api/wifi/scan[?start=1]   [PIN]
 *
 * Implements: REQ-WEB-04, REQ-WEB-07 (the scan runs asynchronously; the page
 * polls). A scan hops over all channels, so reception pauses briefly: it only
 * happens when the user asks for it with ?start=1 (REQ-NET-05 rationale).
 */
static void handleWifiScan() {
    touch();
    if (!requirePin()) return;

    if (s_server.hasArg("start") && WiFi.scanComplete() != WIFI_SCAN_RUNNING) {
        WiFi.scanDelete();
        netPrepareScan();
        WiFi.scanNetworks(true);                         // true = do not block
    }

    const int found = WiFi.scanComplete();
    ChunkedOut out(s_server);
    out.begin("application/json");
    out.objStart();
    out.kBool("scanning", found == WIFI_SCAN_RUNNING);

    out.key("networks"); out.arrStart();
    for (int i = 0; i < found && i < 20; i++) {
        if (WiFi.SSID(i).length() == 0) continue;        // hidden network
        out.objStart();
        out.kStr("ssid", WiFi.SSID(i).c_str());
        out.kNum("rssi", WiFi.RSSI(i));
        out.kNum("channel", WiFi.channel(i));
        out.kBool("secure", WiFi.encryptionType(i) != WIFI_AUTH_OPEN);
        out.objEnd();
    }
    out.arrEnd();
    out.objEnd();
    out.finish();
}

/**
 * POST /api/wifi  (ssid, pass)   [PIN]
 *
 * Implements: REQ-UI-09, REQ-UI-10. The credentials are stored and the server
 * starts joining the router at once; the page polls /api/state for the result.
 */
static void handleWifiSave() {
    touch();
    if (!requirePin()) return;

    const String ssid = s_server.arg("ssid");
    const String pass = s_server.arg("pass");
    if (ssid.length() < 1 || ssid.length() > 32) { sendError(400, "SSID must be 1-32 characters"); return; }
    if (pass.length() != 0 && (pass.length() < 8 || pass.length() > 64)) {
        sendError(400, "password must be 8-64 characters (or empty for an open network)");
        return;
    }

    strncpy(g_settings.ssid, ssid.c_str(), sizeof(g_settings.ssid) - 1);
    strncpy(g_settings.pass, pass.c_str(), sizeof(g_settings.pass) - 1);
    settingsSave();
    sendOk();                                            // answer BEFORE the radio changes
    netApplyCredentials();
}

// ---------------------------------------------------------------------------
// Settings: nodes, room, PIN
// ---------------------------------------------------------------------------

/**
 * POST /api/node  (id, [name], [corner], [offset])   [PIN]
 * Implements: REQ-NODE-02, REQ-NODE-04. `offset` is the CPU offset in 0.01 C.
 */
static void handleNodeEdit() {
    touch();
    if (!requirePin()) return;

    long id;
    if (!argInt("id", 0, 255, &id)) { sendError(400, "id missing"); return; }
    const int idx = nodeFindIndex((uint8_t)id);
    if (idx < 0) { sendError(404, "unknown node"); return; }

    long v;
    if (s_server.hasArg("name")) {
        if (s_server.arg("name").length() > ARG_MAX_LEN) { sendError(400, "name too long"); return; }
        nodeSetName(idx, s_server.arg("name").c_str());
    }
    if (s_server.hasArg("corner")) {
        if (!argInt("corner", 0, 3, &v)) { sendError(400, "corner must be 0-3"); return; }
        nodeSetCorner(idx, (uint8_t)v);
    }
    if (s_server.hasArg("offset")) {
        if (!argInt("offset", -5000, 5000, &v)) { sendError(400, "offset out of range"); return; }
        g_nodes[idx].cpuOffsetCc = (int16_t)v;
    }

    // A corner swap changes another slot too: save them all (cheap, rare).
    for (int i = 0; i < MAX_NODES; i++) if (g_nodes[i].used) storeSaveNode(i);
    sendOk();
}

/** POST /api/node/delete  (id)   [PIN]. Implements: REQ-NODE-03. */
static void handleNodeDelete() {
    touch();
    if (!requirePin()) return;

    long id;
    if (!argInt("id", 0, 255, &id)) { sendError(400, "id missing"); return; }
    const int idx = nodeFindIndex((uint8_t)id);
    if (idx < 0) { sendError(404, "unknown node"); return; }

    nodeForget(idx);
    storeSaveNode(idx);                                  // stored as "free"
    storeMarkHistoryDirty();
    sendOk();
}

/** POST /api/room  (name)   [PIN]. Implements: REQ-UI-09. */
static void handleRoom() {
    touch();
    if (!requirePin()) return;

    const String name = s_server.arg("name");
    if (name.length() < 1 || name.length() > sizeof(g_settings.room) - 1) {
        sendError(400, "room name must be 1-24 characters");
        return;
    }
    memset(g_settings.room, 0, sizeof(g_settings.room));
    for (size_t i = 0; i < name.length(); i++) {
        g_settings.room[i] = ((uint8_t)name[i] < 0x20) ? ' ' : name[i];
    }
    settingsSave();
    sendOk();
}

/** POST /api/pin  (new)   [PIN]. Implements: REQ-SEC-01. */
static void handlePinChange() {
    touch();
    if (!requirePin()) return;

    const String fresh = s_server.arg("new");
    if (!isValidPin(fresh)) { sendError(400, "PIN must be 4-8 digits"); return; }

    strncpy(g_settings.pin, fresh.c_str(), sizeof(g_settings.pin) - 1);
    settingsSave();
    sendOk();
}

/** POST /api/auth   [PIN]: lets the page check a PIN before showing settings. */
static void handleAuth() {
    touch();
    if (requirePin()) sendOk();
}

/** POST /api/history/clear   [PIN]. Implements: REQ-HIST-07 (MAY). */
static void handleHistoryClear() {
    touch();
    if (!requirePin()) return;
    storeClearHistory();
    sendOk();
}

// ---------------------------------------------------------------------------
// Restart and factory reset (delayed so the answer can be delivered first)
// ---------------------------------------------------------------------------

enum PendingAction : uint8_t { ACT_NONE, ACT_RESTART, ACT_FACTORY_RESET };
static PendingAction s_pending      = ACT_NONE;
static uint32_t      s_pendingAtMs  = 0;

static void schedule(PendingAction a) {
    s_pending = a;
    s_pendingAtMs = millis() + 500;       // give the HTTP answer time to leave
}

/** POST /api/restart   [PIN]. History is saved first (REQ-PERS-02). */
static void handleRestart() {
    touch();
    if (!requirePin()) return;
    sendOk();
    schedule(ACT_RESTART);
}

/** POST /api/factory-reset  (confirm=RESET)   [PIN]. Implements: REQ-PERS-06. */
static void handleFactoryReset() {
    touch();
    if (!requirePin()) return;
    if (s_server.arg("confirm") != "RESET") { sendError(400, "confirmation missing"); return; }
    sendOk();
    schedule(ACT_FACTORY_RESET);
}

// ---------------------------------------------------------------------------
// Public API
// ---------------------------------------------------------------------------

/**
 * Register routes and start the server.
 * Implements: REQ-WEB-01. The X-Pin header must be listed to be readable.
 */
void webBegin() {
    static const char *kHeaders[] = {"X-Pin"};
    s_server.collectHeaders(kHeaders, 1);

    s_server.on("/",                   HTTP_GET,  handleRoot);
    s_server.on("/api/state",          HTTP_GET,  handleState);
    s_server.on("/api/history",        HTTP_GET,  handleHistory);
    s_server.on("/api/export.csv",     HTTP_GET,  handleExportCsv);
    s_server.on("/api/auth",           HTTP_POST, handleAuth);
    s_server.on("/api/wifi/scan",      HTTP_GET,  handleWifiScan);
    s_server.on("/api/wifi",           HTTP_POST, handleWifiSave);
    s_server.on("/api/node",           HTTP_POST, handleNodeEdit);
    s_server.on("/api/node/delete",    HTTP_POST, handleNodeDelete);
    s_server.on("/api/room",           HTTP_POST, handleRoom);
    s_server.on("/api/pin",            HTTP_POST, handlePinChange);
    s_server.on("/api/history/clear",  HTTP_POST, handleHistoryClear);
    s_server.on("/api/restart",        HTTP_POST, handleRestart);
    s_server.on("/api/factory-reset",  HTTP_POST, handleFactoryReset);
    s_server.onNotFound(handleNotFound);

    s_server.begin();
    DBG_PRINTF("WEB: server started on port 80");
}

/** Serve requests and carry out a scheduled restart / factory reset. */
void webTick(uint32_t nowMs) {
    s_server.handleClient();

    if (s_pending != ACT_NONE && (int32_t)(nowMs - s_pendingAtMs) >= 0) {
        if (s_pending == ACT_FACTORY_RESET) {
            storeFactoryReset();                 // never returns
        }
        snapshotSave();
        DBG_PRINTF("WEB: restarting on request");
        delay(100);
        ESP.restart();
    }
}
